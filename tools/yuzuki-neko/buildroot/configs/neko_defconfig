## tools/yuzuki-neko/buildroot/configs/neko_defconfig
```kconfig
BR2_riscv=y
BR2_riscv_g=y
BR2_RISCV_ISA_RVC=y
BR2_RISCV_32=y
BR2_RISCV_ABI_ILP32D=y
BR2_TOOLCHAIN_EXTERNAL=y
BR2_TOOLCHAIN_EXTERNAL_BOOTLIN=y
BR2_TOOLCHAIN_EXTERNAL_BOOTLIN_RISCV32_ILP32D_MUSL_STABLE=y
BR2_STATIC_LIBS=y
BR2_OPTIMIZE_S=y
BR2_TARGET_GENERIC_HOSTNAME="neko"
BR2_TARGET_GENERIC_ISSUE="Asterinas RV32 / Yuzuki Neko"
BR2_INIT_NONE=y
# BR2_TARGET_GENERIC_GETTY is not set
# BR2_TARGET_GENERIC_REMOUNT_ROOTFS_RW is not set
BR2_SYSTEM_BIN_SH_BUSYBOX=y
BR2_ROOTFS_OVERLAY="$(BR2_EXTERNAL_NEKO_PATH)/overlay"
BR2_ROOTFS_POST_BUILD_SCRIPT="$(BR2_EXTERNAL_NEKO_PATH)/post-build.sh"
BR2_PACKAGE_BUSYBOX_CONFIG="$(BR2_EXTERNAL_NEKO_PATH)/busybox.config"
BR2_TARGET_ROOTFS_CPIO=y
# BR2_TARGET_ROOTFS_TAR is not set
```
